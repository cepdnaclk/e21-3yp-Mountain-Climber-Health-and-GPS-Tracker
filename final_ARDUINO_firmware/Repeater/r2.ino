#include <SPI.h>
#include <LoRa.h>

/*
  CLIMBER OFF-GRID LoRa REPEATER
  --------------------------------
  Compatible with the user's current raw LoRa.h packet format.

  Mesh-style behavior inspired by Meshtastic:
    - Flood/relay every valid packet
    - Duplicate suppression using a packet hash cache
    - Random relay delay to reduce collisions
    - Priority handling for SOS, SOS_CLEAR and MSG packets
    - Exact packet forwarding, so the existing climber/base code needs no change

  IMPORTANT:
  This is NOT directly interoperable with official Meshtastic firmware because
  Meshtastic uses its own binary packet protocol, encryption and radio settings.
*/

// ---------------- Node identity ----------------
#define REPEATER_ID "REPEATER01"

// ---------------- SX1278 / Ra-02 pins ----------------
#define LORA_SCK   18
#define LORA_MISO  19
#define LORA_MOSI  23
#define LORA_SS    5
#define LORA_RST   14
#define LORA_DIO0  26
#define LORA_BAND  433E6

// Optional status LED. Set to -1 if your board has no usable LED.
#define STATUS_LED 2

// ---------------- Must match climber and base ----------------
#define LORA_SF       8
#define LORA_BW       125E3
#define LORA_CR_DENOM 5
#define LORA_TX_POWER 17

// ---------------- Repeater behavior ----------------
const uint16_t MAX_PACKET_LEN = 235;
const uint8_t  QUEUE_SIZE = 8;
const uint8_t  CACHE_SIZE = 48;

// Keep hashes long enough that repeated base/climber transmissions and
// packets echoed by another repeater cannot form a loop.
const uint32_t CACHE_LIFETIME_MS = 120000UL;

// Random forwarding delay. Urgent packets use the shorter range.
const uint16_t NORMAL_DELAY_MIN_MS = 120;
const uint16_t NORMAL_DELAY_MAX_MS = 420;
const uint16_t URGENT_DELAY_MIN_MS = 35;
const uint16_t URGENT_DELAY_MAX_MS = 110;

// Small guard time between this node's transmissions.
const uint16_t TX_GUARD_MS = 80;

struct SeenPacket {
  uint32_t hash;
  uint32_t seenAt;
  bool used;
};

struct RelayItem {
  String payload;
  uint32_t hash;
  uint32_t dueAt;
  int16_t rxRssi;
  float rxSnr;
  bool urgent;
  bool used;
};

SeenPacket seenCache[CACHE_SIZE];
RelayItem relayQueue[QUEUE_SIZE];

uint8_t nextCacheSlot = 0;
uint32_t lastTxAt = 0;
uint32_t packetsReceived = 0;
uint32_t packetsRelayed = 0;
uint32_t duplicatesDropped = 0;
uint32_t queueDrops = 0;

// -----------------------------------------------------------------------------
// Utility helpers
// -----------------------------------------------------------------------------
uint32_t fnv1aHash(const String& text) {
  uint32_t hash = 2166136261UL;
  for (size_t i = 0; i < text.length(); i++) {
    hash ^= (uint8_t)text[i];
    hash *= 16777619UL;
  }
  return hash;
}

bool timeReached(uint32_t now, uint32_t target) {
  return (int32_t)(now - target) >= 0;
}

bool isUrgentPacket(const String& packet) {
  return packet.indexOf("TYPE:SOS") >= 0 ||
         packet.indexOf("TYPE:SOS_CLEAR") >= 0 ||
         packet.indexOf("TYPE:MSG") >= 0 ||
         packet.indexOf(",SOS:1") >= 0;
}

bool looksLikeProjectPacket(const String& packet) {
  // Reject noise and malformed packets, but accept every packet type currently
  // generated by the climber and basecamp programs.
  if (packet.length() < 6 || packet.length() > MAX_PACKET_LEN) return false;
  if (!packet.startsWith("TYPE:")) return false;

  return packet.indexOf("TYPE:DATA") >= 0 ||
         packet.indexOf("TYPE:MSG") >= 0 ||
         packet.indexOf("TYPE:SOS") >= 0 ||
         packet.indexOf("TYPE:SOS_CLEAR") >= 0 ||
         packet.indexOf("TYPE:BASE") >= 0;
}

void blinkLed(uint16_t durationMs) {
#if STATUS_LED >= 0
  digitalWrite(STATUS_LED, HIGH);
  delay(durationMs);
  digitalWrite(STATUS_LED, LOW);
#else
  (void)durationMs;
#endif
}

// -----------------------------------------------------------------------------
// Duplicate suppression
// -----------------------------------------------------------------------------
void expireOldCacheEntries(uint32_t now) {
  for (uint8_t i = 0; i < CACHE_SIZE; i++) {
    if (seenCache[i].used &&
        (uint32_t)(now - seenCache[i].seenAt) > CACHE_LIFETIME_MS) {
      seenCache[i].used = false;
    }
  }
}

bool wasSeenRecently(uint32_t hash, uint32_t now) {
  for (uint8_t i = 0; i < CACHE_SIZE; i++) {
    if (!seenCache[i].used) continue;

    if ((uint32_t)(now - seenCache[i].seenAt) > CACHE_LIFETIME_MS) {
      seenCache[i].used = false;
      continue;
    }

    if (seenCache[i].hash == hash) return true;
  }
  return false;
}

void rememberPacket(uint32_t hash, uint32_t now) {
  // Prefer an unused slot.
  for (uint8_t i = 0; i < CACHE_SIZE; i++) {
    if (!seenCache[i].used) {
      seenCache[i].hash = hash;
      seenCache[i].seenAt = now;
      seenCache[i].used = true;
      return;
    }
  }

  // Cache full: replace slots in circular order.
  seenCache[nextCacheSlot].hash = hash;
  seenCache[nextCacheSlot].seenAt = now;
  seenCache[nextCacheSlot].used = true;
  nextCacheSlot = (nextCacheSlot + 1) % CACHE_SIZE;
}

// -----------------------------------------------------------------------------
// Relay queue
// -----------------------------------------------------------------------------
int findFreeQueueSlot() {
  for (uint8_t i = 0; i < QUEUE_SIZE; i++) {
    if (!relayQueue[i].used) return i;
  }
  return -1;
}

int findReplaceableNormalSlot() {
  // If an urgent command arrives while the queue is full, sacrifice one normal
  // telemetry packet rather than losing the emergency/control packet.
  for (uint8_t i = 0; i < QUEUE_SIZE; i++) {
    if (relayQueue[i].used && !relayQueue[i].urgent) return i;
  }
  return -1;
}

void enqueueForRelay(const String& packet, uint32_t hash,
                     int16_t rssi, float snr, bool urgent) {
  int slot = findFreeQueueSlot();

  if (slot < 0 && urgent) {
    slot = findReplaceableNormalSlot();
  }

  if (slot < 0) {
    queueDrops++;
    Serial.println("DROP queue_full");
    return;
  }

  uint16_t delayMs = urgent
      ? random(URGENT_DELAY_MIN_MS, URGENT_DELAY_MAX_MS + 1)
      : random(NORMAL_DELAY_MIN_MS, NORMAL_DELAY_MAX_MS + 1);

  relayQueue[slot].payload = packet;
  relayQueue[slot].hash = hash;
  relayQueue[slot].dueAt = millis() + delayMs;
  relayQueue[slot].rxRssi = rssi;
  relayQueue[slot].rxSnr = snr;
  relayQueue[slot].urgent = urgent;
  relayQueue[slot].used = true;
}

int nextDueQueueSlot(uint32_t now) {
  int selected = -1;

  for (uint8_t i = 0; i < QUEUE_SIZE; i++) {
    if (!relayQueue[i].used || !timeReached(now, relayQueue[i].dueAt)) continue;

    if (selected < 0) {
      selected = i;
      continue;
    }

    // Urgent packets always go first. Within the same priority, send the packet
    // whose due time is older.
    if (relayQueue[i].urgent && !relayQueue[selected].urgent) {
      selected = i;
    } else if (relayQueue[i].urgent == relayQueue[selected].urgent &&
               (int32_t)(relayQueue[i].dueAt - relayQueue[selected].dueAt) < 0) {
      selected = i;
    }
  }

  return selected;
}

// -----------------------------------------------------------------------------
// Hop counting
// -----------------------------------------------------------------------------
// Increments the HOP field in a packet before this repeater retransmits it, so
// the basecamp can tell a direct climber packet (HOP:0) apart from one that
// passed through one or more repeaters (HOP:1, HOP:2, ...). If a packet has no
// HOP field at all (older/incompatible firmware), one is appended as HOP:1.
String bumpHop(const String& packet) {
  int idx = packet.indexOf("HOP:");
  bool atFieldStart = idx == 0 || (idx > 0 && packet.charAt(idx - 1) == ',');

  if (idx < 0 || !atFieldStart) {
    return packet + ",HOP:1";
  }

  int valStart = idx + 4;
  int valEnd = packet.indexOf(",", valStart);
  if (valEnd < 0) valEnd = packet.length();

  int hop = packet.substring(valStart, valEnd).toInt() + 1;

  return packet.substring(0, valStart) + String(hop) + packet.substring(valEnd);
}

void relayOneQueuedPacket() {
  uint32_t now = millis();
  if ((uint32_t)(now - lastTxAt) < TX_GUARD_MS) return;

  int slot = nextDueQueueSlot(now);
  if (slot < 0) return;

  String packet = relayQueue[slot].payload;
  bool urgent = relayQueue[slot].urgent;
  int16_t originalRssi = relayQueue[slot].rxRssi;
  float originalSnr = relayQueue[slot].rxSnr;

  // Free the queue slot before transmitting.
  relayQueue[slot].payload = "";
  relayQueue[slot].used = false;

  String outgoing = bumpHop(packet);

  LoRa.idle();
  LoRa.beginPacket();
  LoRa.print(outgoing);                // Forwarded with HOP incremented.
  int result = LoRa.endPacket();      // Blocking transmission.
  lastTxAt = millis();
  LoRa.receive();

  if (result == 1) {
    packetsRelayed++;
    Serial.print("RELAY ");
    Serial.print(urgent ? "URGENT" : "NORMAL");
    Serial.print(" RX_RSSI=");
    Serial.print(originalRssi);
    Serial.print(" RX_SNR=");
    Serial.print(originalSnr, 1);
    Serial.print(" LEN=");
    Serial.println(outgoing.length());
    blinkLed(15);
  } else {
    Serial.println("ERROR relay_failed");
  }
}

// -----------------------------------------------------------------------------
// Radio receive
// -----------------------------------------------------------------------------
void receivePackets() {
  int packetSize = LoRa.parsePacket();
  if (!packetSize) return;

  String incoming;
  incoming.reserve(packetSize);

  while (LoRa.available()) {
    incoming += (char)LoRa.read();
  }

  int16_t rssi = LoRa.packetRssi();
  float snr = LoRa.packetSnr();
  uint32_t now = millis();
  packetsReceived++;

  if (!looksLikeProjectPacket(incoming)) {
    Serial.print("DROP invalid LEN=");
    Serial.println(incoming.length());
    return;
  }

  uint32_t hash = fnv1aHash(incoming);

  if (wasSeenRecently(hash, now)) {
    duplicatesDropped++;
    Serial.print("DROP duplicate HASH=");
    Serial.println(hash, HEX);
    return;
  }

  // Mark it before queueing. This is essential: another repeater may echo the
  // same packet before our randomized forwarding delay expires.
  rememberPacket(hash, now);

  bool urgent = isUrgentPacket(incoming);
  enqueueForRelay(incoming, hash, rssi, snr, urgent);

  Serial.print("RX ");
  Serial.print(urgent ? "URGENT" : "NORMAL");
  Serial.print(" RSSI=");
  Serial.print(rssi);
  Serial.print(" SNR=");
  Serial.print(snr, 1);
  Serial.print(" HASH=");
  Serial.println(hash, HEX);
}

void printStats() {
  static uint32_t lastStatsAt = 0;
  if ((uint32_t)(millis() - lastStatsAt) < 10000UL) return;
  lastStatsAt = millis();

  uint8_t queued = 0;
  for (uint8_t i = 0; i < QUEUE_SIZE; i++) {
    if (relayQueue[i].used) queued++;
  }

  Serial.print("STATS rx=");
  Serial.print(packetsReceived);
  Serial.print(" relayed=");
  Serial.print(packetsRelayed);
  Serial.print(" duplicates=");
  Serial.print(duplicatesDropped);
  Serial.print(" queueDrops=");
  Serial.print(queueDrops);
  Serial.print(" queued=");
  Serial.println(queued);
}

// -----------------------------------------------------------------------------
// Arduino setup / loop
// -----------------------------------------------------------------------------
void setup() {
  Serial.begin(115200);
  delay(500);

#if STATUS_LED >= 0
  pinMode(STATUS_LED, OUTPUT);
  digitalWrite(STATUS_LED, LOW);
#endif

  // Mix timer noise into the randomized relay delays so repeaters do not all
  // retransmit at exactly the same moment after power-up.
  randomSeed((uint32_t)micros() ^ (uint32_t)analogRead(34));

  SPI.begin(LORA_SCK, LORA_MISO, LORA_MOSI, LORA_SS);
  LoRa.setPins(LORA_SS, LORA_RST, LORA_DIO0);

  if (!LoRa.begin(LORA_BAND)) {
    Serial.println("FATAL LoRa initialization failed");
    while (true) {
      blinkLed(150);
      delay(850);
    }
  }

  // These values exactly match c1.ino and b1.ino.
  LoRa.setSpreadingFactor(LORA_SF);
  LoRa.setSignalBandwidth(LORA_BW);
  LoRa.setCodingRate4(LORA_CR_DENOM);
  LoRa.setTxPower(LORA_TX_POWER);
  // CRC is intentionally left at the LoRa library default because the existing
  // climber and basecamp sketches do not enable explicit payload CRC.
  LoRa.receive();

  Serial.print("READY ");
  Serial.print(REPEATER_ID);
  Serial.println(" 433MHz SF8 BW125 CR4/5 TX17dBm");
  blinkLed(100);
}

void loop() {
  receivePackets();
  relayOneQueuedPacket();

  static uint32_t lastCacheCleanup = 0;
  if ((uint32_t)(millis() - lastCacheCleanup) > 10000UL) {
    lastCacheCleanup = millis();
    expireOldCacheEntries(lastCacheCleanup);
  }

  printStats();
  yield();
}
